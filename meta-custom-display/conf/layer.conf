## meta-custom-display/conf/layer.conf
```bitbake
BBPATH .= ":${LAYERDIR}"
BBFILES += "${LAYERDIR}/recipes-*/*/*.bb ${LAYERDIR}/recipes-*/*/*.bbappend"

BBFILE_COLLECTIONS += "custom-display"
BBFILE_PATTERN_custom-display = "^${LAYERDIR}/"
BBFILE_PRIORITY_custom-display = "10"
LAYERSERIES_COMPAT_custom-display = "mickledore"
```
